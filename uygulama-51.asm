	LIST P=16F877A
	#INCLUDE <P16F877A.INC>
	SAYICI1 EQU 0X20
	SAYICI2 EQU 0X21
	ORG 0X000
	GOTO ANA_METOT
	ORG 0X004

KESME_METOT
	BTFSS PIR1,ADIF
	RETFIE
	BCF PIR1,ADIF

	BANKSEL ADRESH
	MOVF ADRESH,W
	BANKSEL PORTC
	MOVWF PORTC

	BANKSEL ADRESL
	MOVF ADRESL,W
	BANKSEL PORTB
	MOVWF PORTB

;ADC_DONUSUM
	MOVF PORTB,W
	SUBLW D'153'
	BTFSS STATUS,Z
	GOTO LED_SONDUR
	GOTO LED_YAK

	BSF ADCON0,GO
	CALL GECIKME

;	BSF ADCON0,GO
;	CALL GECIKME

	RETFIE

ANA_METOT
	BANKSEL TRISB
	CLRF TRISB
	CLRF TRISC
	MOVLW 0XFF
	MOVWF TRISD
	MOVWF TRISE

	MOVLW B'10000000'
	MOVWF ADCON1

	BANKSEL PORTB
	CLRF PORTB
	CLRF PORTC
	MOVLW 0XFF
	MOVWF PORTD
	MOVWF PORTE

	BANKSEL ADCON0
	MOVLW B'11101001'
	MOVWF ADCON0
	CALL GECIKME
	BANKSEL ADCON0

	BANKSEL INTCON
	MOVLW B'11000000'
	MOVWF INTCON
	BANKSEL INTCON

	BANKSEL PIE1
	BSF PIE1,ADIE
	BANKSEL PIE1

	BANKSEL PIR1
	BCF PIR1,ADIF
	BANKSEL PIR1	

DONUSTURME_METOT
	BSF ADCON0,GO
	CALL GECIKME

LED_SONDUR
	BCF PORTD,3
	CALL GECIKME
	BSF ADCON0,GO
	CALL GECIKME
	GOTO KESME_METOT

LED_YAK
	BSF PORTD,3
	CALL GECIKME
	BSF ADCON0,GO
	CALL GECIKME
	GOTO KESME_METOT

KONTROL
	GOTO KONTROL

GECIKME
	MOVLW 0XA0
	MOVWF SAYICI1

TEKRAR1
	MOVLW 0XA0
	MOVWF SAYICI2

TEKRAR2
	DECFSZ SAYICI2,F
	GOTO TEKRAR2
	DECFSZ SAYICI1,F
	GOTO TEKRAR1
	RETURN

END
	